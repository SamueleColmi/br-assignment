## base_external/Config.in
```kconfig
menu "CUSTOM Packages"
    source "$BR2_EXTERNAL_CUSTOM_EXTERNAL_TREE_PATH/package/aesd-assignments/Config.in"
    source "$BR2_EXTERNAL_CUSTOM_EXTERNAL_TREE_PATH/package/ldd/Config.in"
endmenu
```

## base_external/package/ldd/Config.in
```kconfig
config BR2_PACKAGE_LDD
	bool "ldd"
	depends on BR2_LINUX_KERNEL
	help
	  Includes misc-modules and scull components.
	  Used to understand buildroot external trees and package builds.
```
